## main/Kconfig.projbuild
```kconfig
menu "Configuração da Aplicação"

    config ESP_WIFI_SSID
        string "WiFi SSID"
        default "ssid"
        help
            Nome da rede Wifi.

    config ESP_WIFI_PASSWORD
        string "Senha do Wifi"
        default "minha_senha"
        help
            Senha do WiFi (WPA or WPA2).

    config ESP_MAXIMUM_RETRY
        int "Número máximo de tentativas de conexão"
        default 5
        help
            Configure o valor máximo de tentativas de conexão.

    config ESP_MODE
        int "Configuração do modo de atuação da ESP 32"
        default 1
        help
            Configure o modo que a ESP deverá funcionar. Selecione 1 para Energia e 2 para Bateria.

endmenu
```
